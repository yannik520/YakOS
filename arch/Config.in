## arch/Config.in
```kconfig
menu "Architecture Configuration"
config ARCH_ARM
        bool "support ARM architecture"

source "arch/arm/Config.in"
endmenu
```

## arch/arm/Config.in
```kconfig
config BUILD_BOARD_Hi3560
	depends on ARCH_ARM
	bool "bulid for board Hi3560"
config BUILD_BOARD_QEMU
	depends on ARCH_ARM
        bool "bulid for qemu_mini2440"
```

## modules/Config.in
```kconfig
menu "Modules Configuration"

config BUILD_MODULE_HELLO
        tristate "hello module support"
endmenu
```
